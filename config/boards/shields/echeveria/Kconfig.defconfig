## config/boards/shields/echeveria/Kconfig.defconfig
```kconfig
if SHIELD_ECHEVERIA_LEFT

config ZMK_KEYBOARD_NAME
    default "echeveria"

config ZMK_SPLIT_ROLE_CENTRAL
    default y

endif

if SHIELD_ECHEVERIA_LEFT || SHIELD_ECHEVERIA_RIGHT

config ZMK_SPLIT
    default y

endif
```

## config/boards/shields/echeveria/Kconfig.shield
```kconfig
config SHIELD_ECHEVERIA_LEFT
    def_bool $(shields_list_contains,echeveria_left)

config SHIELD_ECHEVERIA_RIGHT
    def_bool $(shields_list_contains,echeveria_right)
```
